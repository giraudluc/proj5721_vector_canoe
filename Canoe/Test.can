/*@!Encoding:1252*/
includes
{

}

variables
{
  int i = 0;
}


void displayMsg(char msg[])
{
  write(msg);
}

on key 't' 
{
  char msg[200] = "Hello word";
  displayMsg(msg);
}

on sysvar_change Test::var1
{
  int64 var1;
  
  var1 = @sysvar::Test::var1;
  writeClear(1);
  write("Var1: %d", var1);
} 

on sysvar_change Test::var2
{
  int64 var2;
  
  var2 = @sysvar::Test::var2;
  writeClear(1);
  write("Var1: %d", var2);
} 

on sysvar_change Test::State1
{
  int64 State1;
  
  State1 = @sysvar::Test::State1;
  writeClear(1);
  write("State1: %d", State1);
} 

on sysvar_change Test::Button1
{
  int64 Button1;
  
  Button1 = @sysvar::Test::Button1;
  writeClear(1);
  write("Button1: %d", Button1);
}
